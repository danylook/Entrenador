## entrenador001/entrenador/main/Kconfig.projbuild
```kconfig
menu "Actividad"
 config ACTIVIDAD_UNO
    string "Primera Actividad"
        default "Camina          "	
        help
            describo primera actividad.

config ACTIVIDAD_DOS
    string "Segunda Actividad"
        default "Come            "
        help
            describo segunda actividad.

config ACTIVIDAD_TRES
    string "Tercera Actividad"
        default "Se acuesta      "
        help
            describo tercera actividad.

config ACTIVIDAD_CUATRO
    string "Cuarta  Actividad"
        default "Se para         "
        help
            describo cuarta actividad.

config ACTIVIDAD_CINCO
    string "Quinta  Actividad"
        default "Acostada        "
        help
            describo quinta actividad.

config ACTIVIDAD_SEIS
    string "Sexta   Actividad"
        default "Mueve la cola   "
        help
            describo sexta actividad.
			
config ACTIVIDAD_SIETE
    string "Septima Actividad"
        default "Mueve la cabeza "
        help
            describo septima actividad.
			
config ACTIVIDAD_OCHO
    string "Octava  Actividad"
        default "Parada          "
        help
            describo octava actividad.



endmenu



menu "SSD1306 Configuration"

    choice INTERFACE
        prompt "Interface"
        default I2C_INTERFACE
        help
            Select Interface.
        config I2C_INTERFACE
            bool "I2C Interface"
            help
                I2C Interface.
        config SPI_INTERFACE
            bool "SPI Interface"
            help
                SPI Interface.
    endchoice

if I2C_INTERFACE

    choice PANEL
        prompt "Panel Type"
        default SSD1306_128x64
        help
            Select Panel Type.
        config SSD1306_128x32
            bool "128x32 Panel"
            help
                Panel is 128x32.
        config SSD1306_128x64
            bool "128x64 Panel"
            help
                Panel is 128x64.
    endchoice

    config SCL_GPIO
        int "SCL GPIO number"
        range 0 34
        default 22
        help
            GPIO number (IOxx) to I2C SCL.
            Some GPIOs are used for other purposes (flash connections, etc.) and cannot be used to I2C.
            GPIOs 35-39 are input-only so cannot be used as outputs.

    config SDA_GPIO
        int "SDA GPIO number"
        range 0 34
        default 21
        help
            GPIO number (IOxx) to I2C SDA.
            Some GPIOs are used for other purposes (flash connections, etc.) and cannot be used to I2C.
            GPIOs 35-39 are input-only so cannot be used as outputs.

endif

    config RESET_GPIO
        int "RESET GPIO number"
        range -1 34
        default -1
        help
            GPIO number (IOxx) to RESET.
            When it is -1, RESET isn't performed.
            Some GPIOs are used for other purposes (flash connections, etc.) and cannot be used to Reset.
            GPIOs 35-39 are input-only so cannot be used as outputs.

if SPI_INTERFACE
    config CS_GPIO
        int "CS GPIO number"
        range 0 34
        default 15
        help
            GPIO number (IOxx) to SPI CS.
            Some GPIOs are used for other purposes (flash connections, etc.) and cannot be used to CS.
            GPIOs 35-39 are input-only so cannot be used as outputs.

    config DC_GPIO
        int "DC GPIO number"
        range 0 34
        default 33
        help
            GPIO number (IOxx) to SPI DC.
            Some GPIOs are used for other purposes (flash connections, etc.) and cannot be used to DC.
            GPIOs 35-39 are input-only so cannot be used as outputs.

endif

endmenu
menu "Example Configuration"

config ROUTER_SSID
    string "Router SSID"
        default "esp-liyin"
        help
            Router SSID.

config ROUTER_PASSWORD
    string "Router password"
        default "espressif"
        help
            Router password.

config MESH_ID
    string "Mesh ID"
        default "123456"
        help
            Mesh network identification, Nodes with the same mesh ID can
            communicate with each other.

config MESH_PASSWORD
    string "Mesh Password"
    default "MESH_PASSWORD"
    help
        Mesh AP password. Password length must be 8 bits smaller than 64 bits,Set to null to not encrypt

config MQTT_URL
    string "MQTT broker URL"
    default "mqtt://iot.eclipse.org"
    help
        URL of the broker to connect to

endmenu
```
